#include "protocol.h"

#include <ArduinoJson.h>

#include "config.h"
#include "illumination.h"
#include "motion.h"

static char line[JSON_LINE_MAX];
static size_t lineLen = 0;

// Which command is still owed a completion message for a given axis.
static int32_t pendingQid[N_AXES];

// --------------------------------------------------------------------------
// Framing
// --------------------------------------------------------------------------
static void openBlock() { Serial.println("++"); }
static void closeBlock() { Serial.println("--"); }

static void sendAck(int32_t qid, int ret = 1) {
    openBlock();
    Serial.print("{\"qid\":");
    Serial.print(qid);
    Serial.print(",\"return\":");
    Serial.print(ret);
    Serial.println("}");
    closeBlock();
}

// {"qid":Q,"steppers":[{"stepperid":I,"position":P,"isDone":1}]}
static void sendAxisDone(int32_t qid, uint8_t axis) {
    openBlock();
    Serial.print("{\"qid\":");
    Serial.print(qid);
    Serial.print(",\"steppers\":[{\"stepperid\":");
    Serial.print(axis);
    Serial.print(",\"position\":");
    Serial.print(stepperPosition(axis));
    Serial.println(",\"isDone\":1}]}");
    closeBlock();
}

// The reply to /motor_get. Steppers are listed in protocol order (A,X,Y,Z),
// because the host indexes its own step-size table by list position.
static void sendMotorState(int32_t qid) {
    openBlock();
    Serial.print("{\"qid\":");
    Serial.print(qid);
    Serial.print(",\"isbusy\":");
    Serial.print(anyStepperBusy() ? 1 : 0);
    Serial.print(",\"motor\":{\"steppers\":[");
    for (uint8_t i = 0; i < N_AXES; ++i) {
        if (i) Serial.print(',');
        Serial.print("{\"stepperid\":");
        Serial.print(i);
        Serial.print(",\"position\":");
        Serial.print(stepperPosition(i));
        Serial.print(",\"isDone\":");
        Serial.print(stepperBusy(i) ? 0 : 1);
        Serial.print('}');
    }
    Serial.println("]}}");
    closeBlock();
}

static void sendState(int32_t qid) {
    openBlock();
    Serial.print("{\"qid\":");
    Serial.print(qid);
    Serial.print(",\"isBusy\":");
    Serial.print(anyStepperBusy() ? 1 : 0);
    Serial.print(",\"heap\":");
    Serial.print((uint32_t)ESP.getFreeHeap());
    Serial.print(",\"state\":{\"identifier_name\":\"" LSFT_FW_NAME "\"");
    Serial.print(",\"identifier_id\":\"" LSFT_FW_VERSION "\"");
    Serial.print(",\"identifier_date\":\"" __DATE__ " " __TIME__ "\"");
    Serial.print(",\"identifier_author\":\"napari-lsft\"");
    Serial.print(",\"pindef\":\"LSFT\"");
    Serial.print(",\"nAxes\":");
    Serial.print(N_AXES);
    Serial.print(",\"nGalvo\":");
    Serial.print(GALVO_N_CHANNELS);
    Serial.print(",\"nLaser\":");
    Serial.print(LASER_N_CHANNELS);
    Serial.println("}}");
    closeBlock();
}

// --------------------------------------------------------------------------
// Endpoints
// --------------------------------------------------------------------------
static void handleLaserAct(JsonDocument &doc, int32_t qid) {
    uint8_t id = doc["LASERid"] | 1;
    uint16_t value = doc["LASERval"] | 0;
    laserSet(id, value);
    sendAck(qid);
}

static void handleLaserSet(JsonDocument &doc, int32_t qid) {
    uint8_t id = doc["LASERid"] | 1;
    int8_t pin = doc["LASERpin"] | -1;
    sendAck(qid, laserSetPin(id, pin) ? 1 : 0);
}

static void handleDacAct(JsonDocument &doc, int32_t qid) {
#if !GALVO_ENABLED
    // The sheet sweep is generated by the UC2 galvo board, not here. The
    // command is still acknowledged so that a host with auto-galvo enabled
    // (the napari widget, acquire_lsft.py) carries on instead of stalling.
    (void)doc;
    sendAck(qid, 0);
#else
    uint8_t channel = doc["dac_channel"] | 1;
    float frequency = doc["frequency"] | 0.0f;
    float amplitude = doc["amplitude"] | 1.0f;
    float offset = doc["offset"] | 0.0f;
    float phase = doc["phase"] | 0.0f;
    bool invert = (doc["invert"] | 0) != 0;
    // "wave" is an LSFT extension; the stock host never sends it and gets the
    // triangle sweep, which illuminates the sheet more evenly than a sine.
    GalvoWave wave = (GalvoWave)(uint8_t)(doc["wave"] | 0);

    galvoConfigure(channel, frequency, amplitude, offset, phase, invert, wave);
    sendAck(qid);
#endif
}

static void handleMotorAct(JsonDocument &doc, int32_t qid) {
    // Absolute step positions, no motion: {"setpos":{"steppers":[...]}}
    JsonArrayConst setpos = doc["setpos"]["steppers"];
    if (!setpos.isNull()) {
        for (JsonObjectConst s : setpos) {
            uint8_t axis = s["stepperid"] | 0;
            if (axis < N_AXES) stepperSetPosition(axis, s["posval"] | 0);
        }
        sendAck(qid);
        return;
    }

    JsonArrayConst steppers = doc["motor"]["steppers"];
    if (steppers.isNull()) {
        // setTrig and friends: accepted so the host does not stall, but this
        // firmware has no hardware trigger output.
        sendAck(qid, 0);
        return;
    }

    // The acknowledgement has to go out before any completion message, because
    // the host counts replies rather than matching them.
    sendAck(qid);

    for (JsonObjectConst s : steppers) {
        uint8_t axis = s["stepperid"] | 0;
        if (axis >= N_AXES) continue;

        if ((s["isstop"] | 0) != 0) {
            pendingQid[axis] = -1;
            stepperStop(axis);
            stepperTakeDone(axis); // a stop is not a move completion
            continue;
        }

        int32_t rawSpeed = s["speed"] | 0;

        MoveRequest req;
        req.speed = (uint32_t)abs(rawSpeed);
        req.accel = s["accel"] | 0;
        req.enable = (s["isen"] | 1) != 0;
        // isaccel=0 means "no ramp"; any acceleration above the tick rate
        // reaches full speed within the first step.
        if ((s["isaccel"] | 1) == 0) req.accel = 1000000UL;

        if ((s["isforever"] | 0) != 0) {
            // move_forever carries the direction in the sign of the speed.
            req.isForever = true;
            req.position = (rawSpeed >= 0) ? 1 : -1;
            pendingQid[axis] = -1;
            stepperMove(axis, req);
            continue;
        }

        req.position = s["position"] | 0;
        req.isAbsolute = (s["isabs"] | 0) != 0;

        stepperTakeDone(axis); // drop a stale flag from an aborted move
        if (stepperMove(axis, req)) {
            pendingQid[axis] = qid;
        } else {
            // Nothing to do for this axis, but the host is counting on one
            // reply per axis it asked to move.
            pendingQid[axis] = -1;
            sendAxisDone(qid, axis);
        }
    }
}

static void handleMotorSet(JsonDocument &doc, int32_t qid) {
    // Pin assignment and limits are compile-time in config.h; only the
    // position part of set_motor is honoured here.
    JsonArrayConst steppers = doc["motor"]["steppers"];
    if (!steppers.isNull()) {
        for (JsonObjectConst s : steppers) {
            uint8_t axis = s["stepperid"] | 0;
            if (axis < N_AXES && s["position"].is<int32_t>())
                stepperSetPosition(axis, s["position"] | 0);
        }
    }
    sendAck(qid);
}

static void handleHomeAct(JsonDocument &doc, int32_t qid) {
    JsonArrayConst steppers = doc["home"]["steppers"];
    if (steppers.isNull()) {
        sendAck(qid, 0);
        return;
    }
    sendAck(qid);
    for (JsonObjectConst s : steppers) {
        uint8_t axis = s["stepperid"] | 0;
        if (axis >= N_AXES) continue;
        uint32_t speed = (uint32_t)abs((int32_t)(s["speed"] | 0));
        int8_t direction = s["direction"] | 1;
        bool polarity = (s["endstoppolarity"] | 0) != 0;
        uint32_t timeoutMs = (uint32_t)(s["timeout"] | 0) * 1000UL;

        stepperTakeDone(axis);
        if (stepperHome(axis, speed, direction, polarity, timeoutMs)) {
            pendingQid[axis] = qid;
        } else {
            pendingQid[axis] = -1;
            sendAxisDone(qid, axis); // no endstop on this axis
        }
    }
}

static void handleStateAct(JsonDocument &doc, int32_t qid) {
    if ((doc["restart"] | 0) != 0) {
        sendAck(qid);
        Serial.flush();
        ESP.restart();
        return;
    }
    uint32_t ms = doc["delay"] | 0;
    if (ms) delay(ms);
    sendAck(qid);
}

// --------------------------------------------------------------------------
// Dispatch
// --------------------------------------------------------------------------
static uint32_t lastCommandMs = 0;

static void dispatch(char *text) {
    JsonDocument doc;
    if (deserializeJson(doc, text)) return; // not JSON: ignore quietly

    lastCommandMs = millis();

    int32_t qid = doc["qid"] | 0; // checkFirmware sends /state_get without one
    const char *task = doc["task"] | "";

    if (!strcmp(task, "/state_get")) sendState(qid);
    else if (!strcmp(task, "/state_set")) sendAck(qid);
    else if (!strcmp(task, "/state_act")) handleStateAct(doc, qid);
    else if (!strcmp(task, "/laser_act")) handleLaserAct(doc, qid);
    else if (!strcmp(task, "/laser_set")) handleLaserSet(doc, qid);
    else if (!strcmp(task, "/dac_act")) handleDacAct(doc, qid);
    else if (!strcmp(task, "/motor_act")) handleMotorAct(doc, qid);
    else if (!strcmp(task, "/motor_get")) sendMotorState(qid);
    else if (!strcmp(task, "/motor_set")) handleMotorSet(doc, qid);
    else if (!strcmp(task, "/home_act")) handleHomeAct(doc, qid);
    else if (!strcmp(task, "/ledarr_act")) sendAck(qid, 0); // no LED matrix
    else sendAck(qid, 0);
}

// --------------------------------------------------------------------------
void protocolBegin() {
    for (uint8_t i = 0; i < N_AXES; ++i) pendingQid[i] = -1;
    lineLen = 0;
    lastCommandMs = millis();
}

#if LASER_WATCHDOG_MS > 0
static void laserWatchdog() {
    if (millis() - lastCommandMs < LASER_WATCHDOG_MS) return;
    for (uint8_t id = 1; id <= LASER_N_CHANNELS; ++id) {
        if (laserGet(id)) {
            laserAllOff();
            break;
        }
    }
}
#endif

void protocolPoll() {
    while (Serial.available()) {
        char c = (char)Serial.read();
        if (c == '\n' || c == '\r') {
            if (lineLen) {
                line[lineLen] = '\0';
                dispatch(line);
                lineLen = 0;
            }
        } else if (lineLen < JSON_LINE_MAX - 1) {
            line[lineLen++] = c;
        } else {
            lineLen = 0; // overlong line: drop it rather than truncate
        }
    }

    for (uint8_t i = 0; i < N_AXES; ++i) {
        if (stepperTakeDone(i) && pendingQid[i] >= 0) {
            sendAxisDone(pendingQid[i], i);
            pendingQid[i] = -1;
        }
    }

#if LASER_WATCHDOG_MS > 0
    laserWatchdog();
#endif
}
